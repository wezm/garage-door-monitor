## buildroot/Config.in
```kconfig
source "$BR2_EXTERNAL_WEZM_PATH/package/garage-door-monitor/Config.in"
source "$BR2_EXTERNAL_WEZM_PATH/package/rsdate/Config.in"
```

## buildroot/package/garage-door-monitor/Config.in
```kconfig
config BR2_PACKAGE_GARAGE_DOOR_MONITOR
        bool "garage-door-monitor"
        depends on BR2_PACKAGE_HOST_RUSTC_TARGET_ARCH_SUPPORTS
        select BR2_PACKAGE_HOST_RUSTC
        help
          A small application that monitors the state of my garage door.

          https://github.com/wezm/garage-door-monitor
```

## buildroot/package/rsdate/Config.in
```kconfig
config BR2_PACKAGE_RSDATE
        bool "rsdate"
        depends on BR2_PACKAGE_HOST_RUSTC_TARGET_ARCH_SUPPORTS
        select BR2_PACKAGE_HOST_RUSTC
        help
          Set or print the time from an ntp server.

          https://github.com/wezm/rsdate
```
